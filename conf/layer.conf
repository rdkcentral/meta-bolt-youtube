## conf/layer.conf
```bitbake
BBPATH .= ":${LAYERDIR}"
BBPATH .= ":${LAYERDIR}/deps/meta-rdk-video"
BBPATH .= ":${LAYERDIR}/deps/meta-rdk-auxiliary"
# BBPATH .= ":${LAYERDIR}/deps/meta-rdk-oss-reference"

BBFILES += "${LAYERDIR}/recipes-*/*/*.bb \
            ${LAYERDIR}/recipes-*/*/*.bbappend"

BBFILES += "${LAYERDIR}/deps/meta-rdk-video/recipes-extended/wpe-framework/*.bb \
            ${LAYERDIR}/deps/meta-rdk-video/recipes-extended/wpe-framework/*.bbappend"

BBFILES += "${LAYERDIR}/deps/meta-rdk-video/recipes-extended/cobalt/*.bb \
            ${LAYERDIR}/deps/meta-rdk-video/recipes-extended/cobalt/*.bbappend"

BBFILES += "${LAYERDIR}/deps/meta-rdk-video/recipes-devtools/gn/*.bb \
            ${LAYERDIR}/deps/meta-rdk-video/recipes-devtools/gn/*.bbappend"

BBFILE_COLLECTIONS += "meta-bolt-youtube"
BBFILE_PATTERN_meta-bolt-youtube = "^${LAYERDIR}/"
BBFILE_PRIORITY_meta-bolt-youtube = "10"

LAYERDEPENDS_meta-bolt-youtube = "bolt-base"
LAYERSERIES_COMPAT_meta-bolt-youtube = "kirkstone"

BUILDOVERRIDES ?= ""
OVERRIDES:append = "${@ ':' + d.getVar('BUILDOVERRIDES') if d.getVar('BUILDOVERRIDES') else '' }"

MIDDLEWARE_ARCH ??= "${TUNE_PKGARCH}"

CMF_GITHUB_ROOT ?= "git://github.com/rdkcentral"
CMF_GITHUB_PROTOCOL = "https"
CMF_GITHUB_BRANCH = "nobranch=1"
CMF_GITHUB_SRC_URI_SUFFIX = "protocol=${CMF_GITHUB_PROTOCOL};${CMF_GITHUB_BRANCH}"
CMF_GITHUB_MAIN_BRANCH ?= "main"
CMF_GITHUB_MASTER_BRANCH ?= "master"
CMF_GITHUB_STABLE2_BRANCH ?= "stable2"

PACKAGECONFIG:append:pn-libloader-app = " firebolt firebolt_lifecycle"
PACKAGECONFIG:append:pn-libloader-app-exp = " firebolt firebolt_lifecycle"
PACKAGECONFIG:append:pn-loader-app = " firebolt firebolt_lifecycle"
PACKAGECONFIG:append:pn-nplb = " firebolt firebolt_lifecycle"

PACKAGECONFIG:remove:pn-libloader-app = "wpecryptography rdkservices"
PACKAGECONFIG:remove:pn-libloader-app-exp = "wpecryptography rdkservices"
PACKAGECONFIG:remove:pn-loader-app = "wpecryptography rdkservices"
PACKAGECONFIG:remove:pn-nplb = "wpecryptography rdkservices"

DEPENDS:append:pn-libloader-app = " wpeframework-corelib"
DEPENDS:append:pn-libloader-app-exp = " wpeframework-corelib"
DEPENDS:append:pn-loader-app = " wpeframework-corelib"
DEPENDS:append:pn-nplb = " wpeframework-corelib"
OPENCDMI_PROVIDER = "rialto-ocdm"

# Remove RDKE workarounds
DEPENDS:remove:pn-libloader-app = "virtual/vendor-secapi2-adapter virtual/vendor-gst-drm-plugins"
DEPENDS:remove:pn-loader-app = "virtual/vendor-secapi2-adapter virtual/vendor-gst-drm-plugins"
DEPENDS:remove:pn-nplb = "virtual/vendor-secapi2-adapter virtual/vendor-gst-drm-plugins"

# Distro features
DISTRO_FEATURES:append = " gstreamer1_18"
DISTRO_FEATURES:append = " thunder_security_disable opencdm enable_icrypto_openssl"
DISTRO_FEATURES:append = " cobalt-27"

# Package config
PACKAGECONFIG:remove:pn-wpeframework-clientlibraries = "powercontroller"
DEPENDS:remove:pn-wpeframework = "rfc"
EXTRA_VERSIONS_PATH ??= "${TMPDIR}/versions"
LOG_BACKTRACE = "n"
```
